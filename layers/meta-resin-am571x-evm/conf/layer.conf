## layers/meta-resin-am571x-evm/conf/layer.conf
```bitbake
BBPATH .= ":${LAYERDIR}"

BBFILES += "${LAYERDIR}/recipes-*/*/*.bb \
            ${LAYERDIR}/recipes-*/*/*.bbappend"

BBFILE_COLLECTIONS += "resin-am571x-evm"
BBFILE_PATTERN_resin-am571x-evm := "^${LAYERDIR}/"
BBFILE_PRIORITY_resin-am571x-evm = "1337"

LAYERDEPENDS_resin-am571x-evm = "core"
LAYERDEPENDS_resin-am571x-evm += "openembedded-layer"
LAYERDEPENDS_resin-am571x-evm += "networking-layer"
LAYERDEPENDS_resin-am571x-evm += "resin-common"
LAYERDEPENDS_resin-am571x-evm += "meta-ti"
```

## layers/meta-resin-am57xx-evm/conf/layer.conf
```bitbake
BBPATH .= ":${LAYERDIR}"

BBFILES += "${LAYERDIR}/recipes-*/*/*.bb \
            ${LAYERDIR}/recipes-*/*/*.bbappend"

BBFILE_COLLECTIONS += "resin-am57xx-evm"
BBFILE_PATTERN_resin-am57xx-evm := "^${LAYERDIR}/"
BBFILE_PRIORITY_resin-am57xx-evm = "1337"

LAYERDEPENDS_resin-am57xx-evm = "core"
LAYERDEPENDS_resin-am57xx-evm += "openembedded-layer"
LAYERDEPENDS_resin-am57xx-evm += "networking-layer"
LAYERDEPENDS_resin-am57xx-evm += "resin-common"
LAYERDEPENDS_resin-am57xx-evm += "meta-ti"
```
